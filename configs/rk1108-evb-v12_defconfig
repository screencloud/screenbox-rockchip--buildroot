## configs/rk1108-evb-v12_defconfig
```kconfig
BR2_arm=y
BR2_cortex_a7=y
BR2_ARM_FPU_NEON_VFPV4=y
BR2_OPTIMIZE_3=y
BR2_SSP_STRONG=y
BR2_SHARED_STATIC_LIBS=y
BR2_TOOLCHAIN_BUILDROOT_VENDOR="rockchip"
BR2_KERNEL_HEADERS_3_10=y
BR2_TOOLCHAIN_BUILDROOT_INET_RPC=y
BR2_TOOLCHAIN_BUILDROOT_LOCALE=y
BR2_PTHREAD_DEBUG=y
BR2_TOOLCHAIN_BUILDROOT_USE_SSP=y
# BR2_UCLIBC_INSTALL_UTILS is not set
BR2_TOOLCHAIN_BUILDROOT_CXX=y
BR2_GCC_ENABLE_LTO=y
BR2_TARGET_OPTIMIZATION="-g -O2 -fstack-protector-strong"
BR2_TARGET_LDFLAGS="-Wl,-Bsymbolic-functions"
BR2_TARGET_GENERIC_HOSTNAME="rockchip"
BR2_TARGET_GENERIC_ISSUE="Welcome to Rockchip"
BR2_TARGET_GENERIC_PASSWD_SHA256=y
BR2_ROOTFS_DEVICE_CREATION_DYNAMIC_MDEV=y
BR2_TARGET_GENERIC_ROOT_PASSWD="$$5$$ytBQnHdG4P09Nju1$$Q/mb6vaZCT1ATC2RHOlrnSPcV15CWPmu749GbI563t2"
BR2_ROOTFS_OVERLAY="board/rockchip/rk1108/fs-overlay"
BR2_ROOTFS_POST_BUILD_SCRIPT="board/rockchip/rk1108/post-build.sh"
BR2_ROOTFS_POST_IMAGE_SCRIPT="board/rockchip/rk1108/post-image.sh"
BR2_ROOTFS_POST_SCRIPT_ARGS="$(BR2_LINUX_KERNEL_INTREE_DTS_NAME)"
BR2_LINUX_KERNEL=y
BR2_LINUX_KERNEL_CUSTOM_LOCAL=y
BR2_LINUX_KERNEL_CUSTOM_LOCAL_PATH="../kernel"
BR2_LINUX_KERNEL_DEFCONFIG="rk1108_defconfig"
BR2_LINUX_KERNEL_APPENDED_ZIMAGE=y
BR2_LINUX_KERNEL_LZO=y
BR2_LINUX_KERNEL_INTREE_DTS_NAME="rk1108-evb-v12"
BR2_PACKAGE_BUSYBOX_CONFIG="board/rockchip/rk1108/busybox.config"
BR2_TARGET_ROOTFS_SQUASHFS=y
# BR2_TARGET_ROOTFS_TAR is not set
```

## configs/rockchip_ScreenboxRk3399_defconfig
```kconfig
#include "rk3399_arm64.config"
#include "base.config"
#include "base_extra.config"
#include "gpu.config"
#include "video_mpp.config"
#include "video_gst.config"
#include "video_gst_rtsp.config"
#include "audio.config"
#include "debug.config"
#include "wifi.config"
#include "network.config"
#include "bt.config"
#include "ntfs.config"
BR2_ROOTFS_OVERLAY="board/rockchip/common/base/ board/rockchip/rk3399/fs-overlay-64/ ../screenbox/overlay/64/ ../screenbox/overlay/noarch/"

BR2_TARGET_GENERIC_HOSTNAME="ScreenboxRk3399"
BR2_TARGET_GENERIC_ISSUE="Welcome to Screenbox RK3399 Buildroot"
BR2_PACKAGE_RKWIFIBT_COMPATIBLE=y
BR2_PACKAGE_RKWIFIBT_BTUART="ttyS0"

############  rkwifibt shenanigans ##############################
# the include "wifi.config" has dropped the following defines
# and modified the "rkwifi" package "somehow" to match these.
# however, the "rkwifi", as of SDK 2.3.1 is somehow broken and didn't work on rockpro64
# hence, we're using the older, known-to-work revision of "rkwifi", but then
# we need to add back these defined for the time being.
# Once we can revert to using upstream rkwifi again, these defines can probably be removed!
#  - user space IEEE 802.1X/WPA supplicant
BR2_PACKAGE_WPA_SUPPLICANT=y
#  - support ap mode for your wifi
BR2_PACKAGE_WPA_SUPPLICANT_AP_SUPPORT=n
#  - enable support for the autoscan feature (allow periodic scan) 
BR2_PACKAGE_WPA_SUPPLICANT_AUTOSCAN=y
#  - enable eap support for your wifi
BR2_PACKAGE_WPA_SUPPLICANT_EAP=y
#  - install wpa_cli command line utility
BR2_PACKAGE_WPA_SUPPLICANT_CLI=n
#  - install libwpa_client.so
BR2_PACKAGE_WPA_SUPPLICANT_WPA_CLIENT_SO=y
#  - install wpa_passphrase command line utility
BR2_PACKAGE_WPA_SUPPLICANT_PASSPHRASE=y
BR2_PACKAGE_WPA_SUPPLICANT_DBUS_NEW=y
BR2_PACKAGE_WPA_SUPPLICANT_DBUS_INTROSPECTION=y

#  - a DHCP client
BR2_PACKAGE_DHCPCD=n

#  - a lightweight DNS and DHCP server. It is intended to provide coupled DNS and DHCP service to a LAN
BR2_PACKAGE_DNSMASQ=n
BR2_PACKAGE_DNSMASQ_DHCP=n
#  - a user space daemon for wireless access points.
BR2_PACKAGE_HOSTAPD=n
########################################################################


BR2_TARGET_ROOTFS_EXT2_SIZE="450M"

BR2_GLOBAL_PATCH_DIR="../screenbox/buildroot_patches"
BR2_TARGET_GENERIC_ROOT_PASSWD=iw72mxiw92jamx6w8dkas

BR2_PACKAGE_IPTABLES=y
BR2_PACKAGE_IPUTILS=y

#SUDO for scplayer
BR2_PACKAGE_SUDO=y

#BASH and readline for scripts
BR2_PACKAGE_BASH=y
BR2_PACKAGE_READLINE=y

#init and logs
BR2_PACKAGE_DAEMON=y

### chrome runtime dependencies
BR2_PACKAGE_LIBNSS=y
BR2_PACKAGE_CA_CERTIFICATES=y
BR2_PACKAGE_FONTCONFIG=y

### video acceleration
BR2_PACKAGE_LIBV4L=y
BR2_PACKAGE_LIBV4L_UTILS=y


### keyboard support
BR2_PACKAGE_LIBXKBCOMMON=y

### LibEvent is needed for NTP
BR2_PACKAGE_LIBEVENT=y


BR2_PACKAGE_UTIL_LINUX=y
BR2_PACKAGE_UTIL_LINUX_LIBBLKID=y


###
###add some fonts. Note: We also add google Noto fonts via FS overlay
BR2_PACKAGE_LIBERATION=y


## TODO: possible to somehow read the existing value (currently "build/post.sh") and *append* ours?
BR2_ROOTFS_POST_BUILD_SCRIPT="build/post.sh ../screenbox/scripts/br_post.sh"

BR2_ROOTFS_USERS_TABLES="../screenbox/usertable.txt"
BR2_ROOTFS_DEVICE_TABLE="../screenbox/permissions.txt"

### enable audio
BR2_PACKAGE_PULSEAUDIO=y
BR2_PACKAGE_PULSEAUDIO_DAEMON=y

## other dependencies of chromium
BR2_PACKAGE_DBUS=y

## need curl for downloads via https proxy
BR2_PACKAGE_CURL=y
BR2_PACKAGE_LIBCURL=y

#stuff for supervisor
BR2_PACKAGE_NODEJS=y
BR2_PACKAGE_NGHTTP2=y
BR2_PACKAGE_NETWORK_MANAGER=y

# psplash (instead of kernel logo)
BR2_USE_WCHAR=y
BR2_PACKAGE_PSPLASH=y

#automount USB stick for provisioning
BR2_PACKAGE_USBMOUNT=y 
BR2_PACKAGE_USBMOUNT_SYNC=y
BR2_PACKAGE_USBUTILS=y

#for increasing partition size
BR2_PACKAGE_PARTED=y

BR2_PACKAGE_UBOOT_TOOLS=y
BR2_PACKAGE_UBOOT_TOOLS_FWPRINTENV=y

#related to OTA
BR2_PACKAGE_OPENSSL=y
BR2_PACKAGE_LIBOPENSSL=y
BR2_PACKAGE_LIBOPENSSL_BIN=y
BR2_PACKAGE_DCRON=y


#to log memory usage
BR2_PACKAGE_PROCPS_NG=y
BR2_PACKAGE_JQ=y

#disable SSHD, might get redefined by "sc_debug_defconfig"
BR2_PACKAGE_OPENSSH=n

###################################
###   Remove unneeded stuff     ###
###################################
BR2_PACKAGE_HOSTAPD=n

BR2_PACKAGE_SOX=n
BR2_PACKAGE_SPEEX=n
BR2_PACKAGE_RKSCRIPT=n
BR2_PACKAGE_PERL=n
BR2_PACKAGE_APP_DEMO=n
BR2_PACKAGE_DHRYSTONE=n
BR2_PACKAGE_GLMARKTEST=n
BR2_PACKAGE_GLMARK2=n
BR2_PACKAGE_GLMARK2_EGL_GLES=n
BR2_PACKAGE_APP_DEMO_IMAGE_PROCESS=n
BR2_PACKAGE_WAYLAND=n
BR2_PACKAGE_WESTON=n
BR2_PACKAGE_GSTREAMER1=n
BR2_PACKAGE_GSTREAMER1_ROCKCHIP=n
BR2_PACKAGE_DOSFSTOOLS=n
BR2_PACKAGE_SQLITE=n

BR2_PACKAGE_LIBFUSE=n
BR2_PACKAGE_EXFAT=n

BR2_PACKAGE_LIBNL=n
BR2_PACKAGE_LIBGLIB2=n
BR2_PACKAGE_LIBICAL=n
BR2_PACKAGE_LMBENCH=n
BR2_PACKAGE_DHRYSTONE=n
BR2_PACKAGE_STRESSAPPTEST=n
BR2_PACKAGE_STRESS=n
BR2_PACKAGE_RT_TESTS=n
BR2_PACKAGE_WHETSTONE=n
BR2_PACKAGE_STRESSAPPTEST=n
BR2_PACKAGE_UNIXBENCH=n

BR2_PACKAGE_ANDROID_TOOLS=n
BR2_PACKAGE_ANDROID_TOOLS_ADBD=n


#TODO maybe remove
BR2_CCACHE=y

BR2_PACKAGE_KNOCK=y
BR2_PACKAGE_OPENSSH=y
```

## configs/rockchip_ScreenboxRk3399_recovery_defconfig
```kconfig
#include "rk3399_arm64.config"
#include "base.config"
#include "base_extra.config"
#include "network.config"
BR2_ROOTFS_OVERLAY="board/rockchip/common/base/ board/rockchip/rk3399/fs-overlay-64/ ../screenbox/overlay_recovery/noarch/"
BR2_ROOTFS_POST_BUILD_SCRIPT="build/post.sh ../screenbox/scripts/br_post_recovery.sh"

BR2_TARGET_ROOTFS_EXT2_SIZE="150M"

BR2_TARGET_GENERIC_HOSTNAME="ScreenboxRk3399-Recovery"
BR2_TARGET_GENERIC_ISSUE="Welcome to Screenbox RK3399 Recovery"

BR2_TARGET_GENERIC_ROOT_PASSWD=iw72mxiw92jamx6w8dkas

BR2_PACKAGE_COREUTILS=y
BR2_PACKAGE_BASH=y
BR2_PACKAGE_READLINE=y

BR2_PACKAGE_NETWORK_MANAGER=y


BR2_GLOBAL_PATCH_DIR="../screenbox/buildroot_patches"

#permit SSH login in recovery
BR2_PACKAGE_OPENSSH=y
BR2_PACKAGE_IPTABLES=y

### keyboard support
BR2_PACKAGE_LIBXKBCOMMON=y

BR2_CCACHE=y

BR2_PACKAGE_DIALOG=y


BR2_PACKAGE_UTIL_LINUX=y
BR2_PACKAGE_UTIL_LINUX_LIBBLKID=y


# psplash (instead of kernel logo)
BR2_USE_WCHAR=y
BR2_PACKAGE_PSPLASH=y

BR2_PACKAGE_USBMOUNT=y 
BR2_PACKAGE_USBMOUNT_SYNC=y
BR2_PACKAGE_USBUTILS=y

#for increasing parition size
BR2_PACKAGE_PARTED=y

BR2_PACKAGE_UBOOT_TOOLS=y
BR2_PACKAGE_UBOOT_TOOLS_FWPRINTENV=y

#related to OTA
BR2_PACKAGE_OPENSSL=y
BR2_PACKAGE_LIBOPENSSL=y
BR2_PACKAGE_LIBOPENSSL_BIN=y
BR2_PACKAGE_DCRON=y

BR2_PACKAGE_IPUTILS=y

### Remove unneeded stuff
BR2_PACKAGE_HOSTAPD=n


BR2_PACKAGE_SOX=n
BR2_PACKAGE_SPEEX=n
BR2_PACKAGE_RKSCRIPT=n
BR2_PACKAGE_PERL=n
BR2_PACKAGE_APP_DEMO=n
BR2_PACKAGE_DHRYSTONE=n
BR2_PACKAGE_GLMARKTEST=n
BR2_PACKAGE_GLMARK2=n
BR2_PACKAGE_GLMARK2_EGL_GLES=n
BR2_PACKAGE_APP_DEMO_IMAGE_PROCESS=n
BR2_PACKAGE_WAYLAND=n
BR2_PACKAGE_WESTON=n
BR2_PACKAGE_GSTREAMER1=n
BR2_PACKAGE_GSTREAMER1_ROCKCHIP=n
BR2_PACKAGE_DOSFSTOOLS=n
BR2_PACKAGE_SQLITE=n

BR2_PACKAGE_LIBFUSE=n
BR2_PACKAGE_EXFAT=n

BR2_PACKAGE_LIBNL=n
BR2_PACKAGE_LIBGLIB2=n
BR2_PACKAGE_LIBICAL=n
BR2_PACKAGE_LMBENCH=n
BR2_PACKAGE_DHRYSTONE=n
BR2_PACKAGE_STRESSAPPTEST=n
BR2_PACKAGE_STRESS=n
BR2_PACKAGE_RT_TESTS=n
BR2_PACKAGE_WHETSTONE=n
BR2_PACKAGE_STRESSAPPTEST=n
BR2_PACKAGE_UNIXBENCH=n

BR2_PACKAGE_ANDROID_TOOLS=n
BR2_PACKAGE_ANDROID_TOOLS_ADBD=n
###


###some useful stuff, mainly for development, can be optimized-away later
BR2_PACKAGE_KMOD_TOOLS=y
BR2_PACKAGE_HTOP=y
BR2_PACKAGE_NANO=y
```

## configs/rockchip_px3se_cut_defconfig
```kconfig
BR2_arm=y
BR2_cortex_a7=y
BR2_ARM_FPU_NEON_VFPV4=y
BR2_ENABLE_DEBUG=y
BR2_OPTIMIZE_3=y
BR2_SSP_STRONG=y
BR2_TOOLCHAIN_BUILDROOT_VENDOR="rockchip"
BR2_KERNEL_HEADERS_3_10=y
BR2_UCLIBC_CONFIG="board/rockchip/px3se/cutting_fs/uClibc-ng.config"
BR2_TOOLCHAIN_BUILDROOT_LOCALE=y
BR2_PTHREAD_DEBUG=y
BR2_TOOLCHAIN_BUILDROOT_USE_SSP=y
# BR2_UCLIBC_INSTALL_UTILS is not set
BR2_TOOLCHAIN_BUILDROOT_CXX=y
BR2_GCC_ENABLE_LTO=y
BR2_TARGET_OPTIMIZATION="-g -O2 -fstack-protector-strong"
BR2_TARGET_LDFLAGS="-Wl,-Bsymbolic-functions"
BR2_TARGET_GENERIC_HOSTNAME="rockchip"
BR2_TARGET_GENERIC_ISSUE="Welcome to Rockchip"
BR2_TARGET_GENERIC_PASSWD_SHA256=y
# BR2_TARGET_ENABLE_ROOT_LOGIN is not set
BR2_ROOTFS_OVERLAY="board/rockchip/px3se/cutting_fs/fs-overlay"
BR2_ROOTFS_POST_BUILD_SCRIPT="board/rockchip/px3se/cutting_fs/post-build.sh"
BR2_PACKAGE_ROCKCHIP=y
BR2_PACKAGE_RK312X=y
BR2_PACKAGE_LIBCUTILS=y
BR2_PACKAGE_ADBD=y
BR2_PACKAGE_BUSYBOX_CONFIG="board/rockchip/px3se/cutting_fs/busybox.config"
# BR2_PACKAGE_FFMPEG_FFMPEG is not set
BR2_PACKAGE_GSTREAMER1=y
# BR2_PACKAGE_GSTREAMER1_TRACE is not set
# BR2_PACKAGE_GSTREAMER1_GST_DEBUG is not set
BR2_PACKAGE_GST1_PLUGINS_BASE_PLUGIN_ALSA=y
BR2_PACKAGE_GST1_PLUGINS_GOOD=y
BR2_PACKAGE_GST1_PLUGINS_GOOD_PLUGIN_AUDIOPARSERS=y
BR2_PACKAGE_GST1_PLUGINS_GOOD_PLUGIN_AUTODETECT=y
BR2_PACKAGE_GST1_PLUGINS_GOOD_PLUGIN_ID3DEMUX=y
BR2_PACKAGE_GST1_PLUGINS_BAD=y
BR2_PACKAGE_GST1_PLUGINS_BAD_PLUGIN_VIDEOPARSERS=y
BR2_PACKAGE_GST1_PLUGINS_UGLY=y
BR2_PACKAGE_GST1_PLUGINS_UGLY_PLUGIN_MAD=y
BR2_PACKAGE_GST1_LIBAV=y
BR2_PACKAGE_MESA3D=y
BR2_PACKAGE_MESA3D_GALLIUM_DRIVER_SWRAST=y
BR2_PACKAGE_MESA3D_OPENGL_EGL=y
BR2_PACKAGE_MESA3D_OPENGL_ES=y
BR2_PACKAGE_QT5=y
BR2_PACKAGE_QT5BASE_LICENSE_APPROVED=y
BR2_PACKAGE_QT5BASE_EXAMPLES=y
BR2_PACKAGE_QT5BASE_SQLITE_QT=y
BR2_PACKAGE_QT5BASE_LINUXFB=y
BR2_PACKAGE_QT5BASE_OPENGL=y
BR2_PACKAGE_QT5BASE_GIF=y
BR2_PACKAGE_QT5BASE_JPEG=y
BR2_PACKAGE_QT5BASE_PNG=y
BR2_PACKAGE_QT5BASE_TSLIB=y
BR2_PACKAGE_QT5CONNECTIVITY=y
BR2_PACKAGE_QT5MULTIMEDIA=y
BR2_PACKAGE_QT5QUICKCONTROLS=y
BR2_PACKAGE_QT5QUICKCONTROLS2=y
BR2_PACKAGE_SBC=y
BR2_PACKAGE_OPENSSL=y
BR2_PACKAGE_DNSMASQ=y
BR2_PACKAGE_HOSTAPD=y
BR2_PACKAGE_IPERF=y
BR2_PACKAGE_IW=y
BR2_PACKAGE_WIRELESS_TOOLS=y
BR2_PACKAGE_WPA_SUPPLICANT=y
BR2_PACKAGE_WPA_SUPPLICANT_CLI=y
BR2_PACKAGE_WPA_SUPPLICANT_WPA_CLIENT_SO=y
BR2_TARGET_ROOTFS_SQUASHFS=y
# BR2_TARGET_ROOTFS_TAR is not set
```

## configs/rockchip_px3se_defconfig
```kconfig
BR2_arm=y
BR2_cortex_a7=y
BR2_ARM_FPU_NEON_VFPV4=y
BR2_CCACHE=y
BR2_ENABLE_DEBUG=y
BR2_TOOLCHAIN_BUILDROOT_VENDOR="rockchip"
BR2_KERNEL_HEADERS_3_10=y
BR2_TOOLCHAIN_BUILDROOT_GLIBC=y
BR2_TOOLCHAIN_BUILDROOT_CXX=y
BR2_TARGET_GENERIC_HOSTNAME="rockchip"
BR2_TARGET_GENERIC_ISSUE="Welcome to Rockchip"
BR2_TARGET_GENERIC_PASSWD_SHA256=y
BR2_ROOTFS_DEVICE_CREATION_DYNAMIC_EUDEV=y
# BR2_TARGET_ENABLE_ROOT_LOGIN is not set
# BR2_TARGET_GENERIC_GETTY is not set
BR2_ROOTFS_OVERLAY="board/rockchip/px3se/fs-overlay"
BR2_ROOTFS_POST_BUILD_SCRIPT="board/rockchip/px3se/post-build.sh"
BR2_PACKAGE_ROCKCHIP=y
BR2_PACKAGE_RK312X=y
BR2_PACKAGE_LIBCUTILS=y
BR2_PACKAGE_ADBD=y
BR2_PACKAGE_BUSYBOX_CONFIG="board/rockchip/px3se/busybox.config"
BR2_PACKAGE_ALSA_UTILS=y
BR2_PACKAGE_ALSA_UTILS_AMIXER=y
BR2_PACKAGE_ALSA_UTILS_APLAY=y
BR2_PACKAGE_GSTREAMER1=y
BR2_PACKAGE_GST1_PLUGINS_BASE_PLUGIN_ALSA=y
BR2_PACKAGE_GST1_PLUGINS_BASE_PLUGIN_VIDEOCONVERT=y
BR2_PACKAGE_GST1_PLUGINS_BASE_PLUGIN_VIDEOTESTSRC=y
BR2_PACKAGE_GST1_PLUGINS_GOOD=y
BR2_PACKAGE_GST1_PLUGINS_GOOD_PLUGIN_AUDIOPARSERS=y
BR2_PACKAGE_GST1_PLUGINS_GOOD_PLUGIN_AUTODETECT=y
BR2_PACKAGE_GST1_PLUGINS_GOOD_PLUGIN_DEINTERLACE=y
BR2_PACKAGE_GST1_PLUGINS_GOOD_PLUGIN_ID3DEMUX=y
BR2_PACKAGE_GST1_PLUGINS_BAD=y
BR2_PACKAGE_GST1_PLUGINS_BAD_PLUGIN_VIDEOPARSERS=y
BR2_PACKAGE_GST1_PLUGINS_UGLY=y
BR2_PACKAGE_GST1_PLUGINS_UGLY_PLUGIN_MAD=y
BR2_PACKAGE_GST1_PLUGINS_UGLY_PLUGIN_MPG123=y
BR2_PACKAGE_GST1_PLUGINS_UGLY_PLUGIN_MPEG2DEC=y
BR2_PACKAGE_GST1_LIBAV=y
BR2_PACKAGE_PULSEAUDIO=y
BR2_PACKAGE_STRACE=y
BR2_PACKAGE_GETTEXT=y
BR2_PACKAGE_E2FSPROGS=y
BR2_PACKAGE_E2FSPROGS_RESIZE2FS=y
BR2_PACKAGE_FBDUMP=y
BR2_PACKAGE_MESA3D=y
BR2_PACKAGE_MESA3D_GALLIUM_DRIVER_SWRAST=y
BR2_PACKAGE_MESA3D_OPENGL_EGL=y
BR2_PACKAGE_MESA3D_OPENGL_ES=y
BR2_PACKAGE_QT5=y
BR2_PACKAGE_QT5BASE_LICENSE_APPROVED=y
BR2_PACKAGE_QT5BASE_EXAMPLES=y
BR2_PACKAGE_QT5BASE_SQLITE_QT=y
BR2_PACKAGE_QT5BASE_LINUXFB=y
BR2_PACKAGE_QT5BASE_EGLFS=y
BR2_PACKAGE_QT5BASE_GIF=y
BR2_PACKAGE_QT5BASE_JPEG=y
BR2_PACKAGE_QT5BASE_PNG=y
BR2_PACKAGE_QT5BASE_TSLIB=y
BR2_PACKAGE_QT5CONNECTIVITY=y
BR2_PACKAGE_QT5MULTIMEDIA=y
BR2_PACKAGE_QT5QUICKCONTROLS=y
BR2_PACKAGE_QT5WAYLAND=y
BR2_PACKAGE_QT5QUICKCONTROLS2=y
BR2_PACKAGE_WESTON=y
BR2_PACKAGE_WESTON_DRM=y
BR2_PACKAGE_WESTON_FBDEV=y
BR2_PACKAGE_WESTON_DEMO_CLIENTS=y
BR2_PACKAGE_SBC=y
BR2_PACKAGE_OPENSSL=y
BR2_PACKAGE_OPENSSL_BIN=y
BR2_PACKAGE_LIBSVG_CAIRO=y
BR2_PACKAGE_BLUEZ5_UTILS=y
BR2_PACKAGE_BLUEZ5_UTILS_OBEX=y
BR2_PACKAGE_BLUEZ5_UTILS_CLIENT=y
BR2_PACKAGE_BLUEZ5_UTILS_GATTTOOL=y
BR2_PACKAGE_BLUEZ5_UTILS_EXPERIMENTAL=y
BR2_PACKAGE_BLUEZ5_PLUGINS_SIXAXIS=y
BR2_PACKAGE_BLUEZ5_UTILS_TEST=y
BR2_PACKAGE_DNSMASQ=y
BR2_PACKAGE_HOSTAPD=y
BR2_PACKAGE_HOSTAPD_EAP=y
BR2_PACKAGE_HOSTAPD_WPS=y
BR2_PACKAGE_IPTABLES=y
BR2_PACKAGE_WPA_SUPPLICANT=y
BR2_PACKAGE_WPA_SUPPLICANT_AP_SUPPORT=y
BR2_PACKAGE_WPA_SUPPLICANT_DEBUG_SYSLOG=y
BR2_PACKAGE_WPA_SUPPLICANT_WPS=y
BR2_PACKAGE_WPA_SUPPLICANT_CLI=y
BR2_PACKAGE_WPA_SUPPLICANT_WPA_CLIENT_SO=y
BR2_PACKAGE_WPA_SUPPLICANT_PASSPHRASE=y
BR2_TARGET_ROOTFS_EXT2=y
BR2_TARGET_ROOTFS_EXT2_4=y
# BR2_TARGET_ROOTFS_TAR is not set
BR2_PACKAGE_HOST_VBOOT_UTILS=y
```

## configs/rockchip_px3se_recovery_defconfig
```kconfig
BR2_arm=y
BR2_cortex_a7=y
BR2_ARM_FPU_VFPV2=y
BR2_DL_DIR="$(TOPDIR)/download"
BR2_KERNEL_HEADERS_4_4=y
BR2_TOOLCHAIN_BUILDROOT_GLIBC=y
BR2_GCC_VERSION_5_X=y
BR2_TOOLCHAIN_BUILDROOT_CXX=y
BR2_ROOTFS_OVERLAY="board/rockchip/px3se/fs-overlay-recovery"
BR2_PACKAGE_ROCKCHIP=y
BR2_PACKAGE_PX3SE=y
BR2_PACKAGE_ADBD=y
BR2_PACKAGE_RECOVERY=y
BR2_PACKAGE_UPDATE=y
BR2_PACKAGE_UEVENTD=y
BR2_PACKAGE_RKUPDATE=y
BR2_PACKAGE_OPENSSL=y
BR2_PACKAGE_LIBSELINUX=y
BR2_TARGET_ROOTFS_CPIO=y
BR2_TARGET_ROOTFS_CPIO_GZIP=y
# BR2_TARGET_ROOTFS_TAR is not set
```
