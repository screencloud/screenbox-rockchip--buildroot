## package/rockchip/bootanimation/Config.in
```kconfig
config BR2_PACKAGE_BOOTANIMATION
	bool "BOOTANIMATION for Linux"
	depends on BR2_PACKAGE_LIBDRM
```

## package/rockchip/gst1-libav-rk/Config.in
```kconfig
config BR2_PACKAGE_GST1_LIBAV_RK
	bool "Gstreamer Rockchip ffmpeg plugins"
	select BR2_PACKAGE_GST1_PLUGINS_BASE
	select BR2_PACKAGE_LIBDRM
	help
	  Rockchip rkvdec video accel Gstreamer plugin.

	  This package contains GStreamer plugins base on
	  the libav project.

          https://github.com/JamesLinEngineer/gst-libav-rk
```

## package/rockchip/mpp/Config.in
```kconfig
config BR2_PACKAGE_MPP
	bool "MPP(Multimedia Processing Platform)"

config BR2_PACKAGE_MPP_TEST
	bool "MPP test bin"
	depends on BR2_PACKAGE_MPP
```

## package/rockchip/mpp_linux_cpp/Config.in
```kconfig
menuconfig BR2_PACKAGE_MPP_LINUX_CPP
	bool "MPP(Multimedia Processing Platform) demo"
        depends on BR2_PACKAGE_MPP
```

## package/rockchip/recovery/Config.in
```kconfig
config BR2_PACKAGE_RECOVERY
	bool "Rockchip recovery for linux"
        select BR2_PACKAGE_LIBDRM
	help
	  Rockchip recovery for linux.
```

## package/rockchip/rk1108-firmware/Config.in
```kconfig
config BR2_PACKAGE_RK1108_FIRMWARE
	bool "rk1108 firmware"
	depends on BR2_PACKAGE_RK1108
```

## package/rockchip/rkwifibt/Config.in
```kconfig
menuconfig BR2_PACKAGE_RKWIFIBT
    bool "rkwifibt"

if BR2_PACKAGE_RKWIFIBT
choice
	default BR2_PACKAGE_RKWIFIBT_AP6212A1
    prompt "wifi chip support"

config BR2_PACKAGE_RKWIFIBT_AP6255
    bool "AP6255"
config BR2_PACKAGE_RKWIFIBT_AP6212A1
    bool "AP6212A1"
config BR2_PACKAGE_RKWIFIBT_AP6335
    bool "AP6335"
endchoice

config BR2_PACKAGE_RKWIFIBT_BTUART
	string "bt uart"
	default "ttyS1"
	depends on BR2_PACKAGE_RKWIFIBT
	help
		tty that bt used
endif
```
